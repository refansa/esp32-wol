## main/Kconfig.projbuild
```kconfig
menu "Project config"

    config WOL_WIFI_SSID
        string "The Wi-Fi SSID"
        default "CHANGEME"
        help
            The SSID (network name) for the program to connect to.

    config WOL_WIFI_PASSWORD
        string "The Wi-Fi Password"
        default "CHANGEME"
        help
            The Wi-Fi password for the program to use.

    config WOL_WIFI_HOSTNAME
        string "Wi-Fi host name"
        default "espressif"
        help
            The Wi-Fi host name that will be displayed when this device is connected.

    config WOL_WIFI_RETRY_ATTEMPT
        int "Wi-Fi retry attempt"
        default 5
        help
            The retry attempt when attempting to connect or re-connect into the Wi-Fi AP station.

    config WOL_HTTP_SERVER_PORT
        int "Http server port"
        default 8000
        help
            The port number to be assigned to the http server.

    config WOL_TARGET_MAC_ADDRESS
        string "Target physical MAC address"
        default "XX:XX:XX:XX:XX:XX"
        help
            The target physical MAC address that will be the receiver of the WoL magic packet.

    config WOL_TARGET_BROADCAST_IP
        string "Target broadcast IP"
        default "255.255.255.255"
        help
            The target broadcast IP that can resolve the physical MAC address.

    config TAILSCALE_AUTH_KEY
        string "Tailscale authentication key"
        default ""
        help
            The Tailscale authentication key, obtain it at the Tailscale Admin Console.

    config TAILSCALE_DEVICE_NAME
        string "Tailscale device name"
        default WOL_WIFI_HOSTNAME
        help
            The Tailscale device name that will appear on the device list, default to WOL_WIFI_HOSTNAME.

endmenu
```
